## sdkconfig.defaults
```kconfig
# libssh2: mbedTLS als Krypto-Backend (aktiviert LIBSSH2_MBEDTLS + mbedTLS-Includes)
CONFIG_LIBSSH2_CRYPTO_ENGINE_MBEDTLS=y

# Flash-Größe (ESP32-CAM AI-Thinker: 4 MB)
CONFIG_ESPTOOLPY_FLASHSIZE_4MB=y
CONFIG_ESPTOOLPY_FLASHSIZE="4MB"

# PSRAM aktivieren (ESP32-CAM AI-Thinker: 8 MB PSRAM)
CONFIG_ESP32_SPIRAM_SUPPORT=y
CONFIG_SPIRAM_SPEED_80M=y
CONFIG_SPIRAM_USE_MALLOC=y
CONFIG_SPIRAM_MALLOC_ALWAYSINTERNAL=16384
# Bank-Switching für vollen 8-MB-Zugriff (ESP32 kann nur 4 MB direkt adressieren)
CONFIG_SPIRAM_BANKSWITCH_ENABLE=y
CONFIG_SPIRAM_BANKSWITCH_RESERVE=8

# Kamera-Framebuffer im PSRAM ablegen
CONFIG_CAMERA_DMA_BUFFER_SIZE_MAX=32768

# lwIP / DNS für SCP
CONFIG_LWIP_DNS_SUPPORT_MDNS_QUERIES=y
CONFIG_LWIP_SO_RCVTIMEO=y
CONFIG_LWIP_SO_SNDTIMEO=y

# Bluetooth deaktivieren — nicht benötigt, spart ~50 KB RAM
CONFIG_BT_ENABLED=n

# NVS für Boot-Zähler
CONFIG_NVS_ENCRYPTION=n

# Log-Level
CONFIG_LOG_DEFAULT_LEVEL_INFO=y
CONFIG_LOG_MAXIMUM_LEVEL_DEBUG=y

# Stack für app_main-Task erhöhen (SCP + Kamera)
CONFIG_ESP_MAIN_TASK_STACK_SIZE=8192
```
